## apps/examples/camera_launcher/Kconfig
```kconfig
config EXAMPLES_CAMERA_LAUNCHER
	bool "Camera Launcher"
	default n
	depends on UORB
	---help---
		Start camera and subscriber together using launcher app
```
